#include <dt-bindings/zmk/matrix_transform.h>
#include "krill-layouts.dtsi"

/ {
    chosen {
      zmk,physical-layout = &physical_layout0;
    };

    center_encoder: center_encoder {
        compatible = "alps,ec11";
        a-gpios = <&pro_micro 3 (GPIO_ACTIVE_HIGH | GPIO_PULL_UP)>;
        b-gpios = <&pro_micro 4 (GPIO_ACTIVE_HIGH | GPIO_PULL_UP)>;
        steps = <80>;
        status = "okay";
    };

    sensors: sensors {
        compatible = "zmk,keymap-sensors";
        sensors = <&center_encoder>;
        triggers-per-rotation = <20>;
    };

};
